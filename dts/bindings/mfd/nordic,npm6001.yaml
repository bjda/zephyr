## dts/bindings/mfd/nordic,npm6001.yaml
```yaml
# Copyright (c) 2022, Nordic Semiconductor ASA
# SPDX-License-Identifier: Apache-2.0

description: Nordic nPM6001

compatible: "nordic,npm6001"

include: i2c-device.yaml

properties:
  reg:
    required: true

  nordic,ready-high-drive:
    type: boolean
    description: Set drive strength to high for READY pin.

  nordic,nint-high-drive:
    type: boolean
    description: Set drive strength to high for NINT pin.

  nordic,sda-high-drive:
    type: boolean
    description: Set drive strength to high for SDA pin.

  nordic,buck-mode0-input-type:
    type: string
    default: "schmitt"
    enum: ["schmitt", "cmos"]
    description: Input type for BUCK_MODE0 pin. Defaults IC boot-time value.

  nordic,buck-mode0-pull-down:
    type: boolean
    description: Enable pull-down resistor for BUCK_MODE0 pin.

  nordic,buck-mode1-input-type:
    type: string
    default: "schmitt"
    enum: ["schmitt", "cmos"]
    description: Input type for BUCK_MODE1 pin. Defaults IC boot-time value.

  nordic,buck-mode1-pull-down:
    type: boolean
    description: Enable pull-down resistor for BUCK_MODE1 pin.

  nordic,buck-mode2-input-type:
    type: string
    default: "schmitt"
    enum: ["schmitt", "cmos"]
    description: Input type for BUCK_MODE2 pin. Defaults IC boot-time value.

  nordic,buck-mode2-pull-down:
    type: boolean
    description: Enable pull-down resistor for BUCK_MODE2 pin.

  startup-timeout-us:
    type: int
    default: 2000
    description: |
        Time to delay initialization if the device does not respond at first, given in microseconds.
        In case the device has just been powered on before initialization, this gives it time to
        boot. If set to 0, initialization will not be retried.
```

## dts/bindings/power-domain/power-domain-regulator.yaml
```yaml
# Copyright (c) 2023, Nordic Semiconductor ASA
# SPDX-License-Identifier: Apache-2.0

description: Regulator power domain

compatible: "power-domain-regulator"

include: power-domain.yaml
```
